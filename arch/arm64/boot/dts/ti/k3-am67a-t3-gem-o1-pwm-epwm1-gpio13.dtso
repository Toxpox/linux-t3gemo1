// SPDX-License-Identifier: GPL-2.0-only OR MIT
/*
 * DT Overlay to use GPIO13 (PWM1) within the expansion header for EPWM1 (pwmchip5).
 *
 * Copyright (C) 2023 Texas Instruments Incorporated - https://www.ti.com/
 */

/dts-v1/;
/plugin/;

#include <dt-bindings/gpio/gpio.h>
#include "k3-pinctrl.h"

/*
 * Helper to show loaded overlays under: /proc/device-tree/chosen/overlays/
*/
&{/chosen} {
	overlays {
		k3-am67a-t3-gem-o1-pwm-epwm1-gpio13.kernel = __TIMESTAMP__;
		hat-33.23010000.pwm = "k3-am67a-t3-gem-o1-pwm-epwm1-gpio13.23010000.1.GPIO13";
		gpio13.23010000.pwm = "k3-am67a-t3-gem-o1-pwm-epwm1-gpio13.23010000.1.GPIO13";
	};
};

/*
 * hat_33_pwm is defined in k3-am67a-t3-gem-o1-pinmux.dtsi and is part of the
 * base DTB, so reference it instead of redefining it here. Redefining a base
 * pin group from an overlay merges into it and silently overrides
 * pinctrl-single,pins, which would make the pinmux.dtsi definition dead.
 */
&epwm1 {
	pinctrl-names = "default";
	pinctrl-0 = <&hat_33_pwm>;
	status = "okay";
};
