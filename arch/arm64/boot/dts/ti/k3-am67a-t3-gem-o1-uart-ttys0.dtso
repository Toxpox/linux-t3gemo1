// SPDX-License-Identifier: GPL-2.0-only OR MIT
/*
 * DT Overlay to use GPIO24 (TX) and GPIO7 (RX) within the expansion header for WKUP_UART0 (ttyS0).
 *
 * WARNING: WKUP_UART0 is reserved for the Device Manager firmware in the base
 * device tree. Loading this overlay takes the port away from DM and disables
 * the DM firmware console.
 *
 * WARNING: mutually exclusive with k3-am67a-t3-gem-o1-spidev0-2cs.dtso. Both
 * claim MCU pad 0x0024 (ball B3, HAT pin 26 / GPIO7): here as WKUP_UART0_RXD,
 * there as MCU_SPI0_CS2. Loading both makes the second consumer fail with
 * -EBUSY in pinmux_request_pin(). Use spidev0-1cs.dtso instead if ttyS0 is
 * needed alongside a HAT spidev.
 *
 * Copyright (C) 2025 T3 Foundation - https://www.t3vakfi.org/
 */

/dts-v1/;
/plugin/;

#include <dt-bindings/gpio/gpio.h>
#include "k3-pinctrl.h"

/*
 * Helper to show loaded overlays under: /proc/device-tree/chosen/overlays/
*/
&{/chosen} {
	overlays {
		k3-am67a-t3-gem-o1-uart-ttys0.kernel = __TIMESTAMP__;
	};
};

/*
 * The WKUP_UART0 pads live in the MCU pinctrl domain (mcu_pmx0, pinctrl@4084000),
 * not in main_pmx0 (pinctrl@f4000). J722S_IOPAD() and J722S_MCU_IOPAD() are
 * identical macros - only the parent controller selects the domain. The pin
 * groups are already defined in k3-am67a-t3-gem-o1-pinmux.dtsi under &mcu_pmx0,
 * so reference them instead of redefining them in the wrong domain.
 */
&wkup_uart0 {
	pinctrl-names = "default";
	pinctrl-0 = <&hat_18_wkup_uart0_txd>, <&hat_26_wkup_uart0_rxd>;
	status = "okay";
};
