// SPDX-License-Identifier: GPL-2.0-only OR MIT
/*
 * DT Overlay to use GPIO16 (PWM0) within the expansion header for ECAP1 (pwmchip1).
 *
 * Copyright (C) 2023 Texas Instruments Incorporated - https://www.ti.com/
 */

/dts-v1/;
/plugin/;

#include <dt-bindings/gpio/gpio.h>
#include "k3-pinctrl.h"

/*
 * Helper to show loaded overlays under: /proc/device-tree/chosen/overlays/
*/
&{/chosen} {
	overlays {
		k3-am67a-t3-gem-o1-pwm-ecap1-gpio16.kernel = __TIMESTAMP__;
		hat-36.23110000.pwm = "k3-am67a-t3-gem-o1-pwm-ecap1-gpio16.23110000.0.GPIO16";
		gpio16.23110000.pwm = "k3-am67a-t3-gem-o1-pwm-ecap1-gpio16.23110000.0.GPIO16";
	};
};

/*
 * hat_36_pwm_ecap is defined in k3-am67a-t3-gem-o1-pinmux.dtsi and is part of
 * the base DTB, so reference it instead of redefining it here. Redefining a
 * base pin group from an overlay merges into it and silently overrides
 * pinctrl-single,pins, which would make the pinmux.dtsi definition dead.
 */
&ecap1 {
	pinctrl-names = "default";
	pinctrl-0 = <&hat_36_pwm_ecap>;
	status = "okay";
};
