// SPDX-License-Identifier: GPL-2.0-only OR MIT
/*
 * DT Overlay to use GPIO5 (PWM0) within the expansion header for EPWM0 (pwmchip3).
 *
 * Copyright (C) 2023 Texas Instruments Incorporated - https://www.ti.com/
 */

/dts-v1/;
/plugin/;

#include <dt-bindings/gpio/gpio.h>
#include "k3-pinctrl.h"

/*
 * Helper to show loaded overlays under: /proc/device-tree/chosen/overlays/
*/
&{/chosen} {
	overlays {
		k3-am67a-t3-gem-o1-pwm-epwm0-gpio5.kernel = __TIMESTAMP__;
		hat-29.23000000.pwm = "k3-am67a-t3-gem-o1-pwm-epwm0-gpio5.23000000.0.GPIO5";
		gpio5.23000000.pwm = "k3-am67a-t3-gem-o1-pwm-epwm0-gpio5.23000000.0.GPIO5";
	};
};

/*
 * hat_29_pwm is defined in k3-am67a-t3-gem-o1-pinmux.dtsi and is part of the
 * base DTB, so reference it instead of redefining it here. Redefining a base
 * pin group from an overlay merges into it and silently overrides
 * pinctrl-single,pins, which would make the pinmux.dtsi definition dead.
 */
&epwm0 {
	pinctrl-names = "default";
	pinctrl-0 = <&hat_29_pwm>;
	status = "okay";
};
